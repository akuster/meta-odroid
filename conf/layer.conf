## conf/layer.conf
```bitbake
# We have a conf and classes directory, add to BBPATH
BBPATH .= ":${LAYERDIR}"

# We have recipes-* directories, add to BBFILES
BBFILES += "${LAYERDIR}/recipes-*/*/*.bb \
        ${LAYERDIR}/recipes-*/*/*.bbappend"

BBFILE_COLLECTIONS += "odroid-layer"
BBFILE_PATTERN_odroid-layer := "^${LAYERDIR}/"
BBFILE_PRIORITY_odroid-layer = "5"

LAYERDEPENDS_odroid-layer = "core"

LAYERSERIES_COMPAT_odroid-layer = "sumo thud"
```

## conf/machine/include/amlogic-meson64.inc
```bitbake
# Amlogic Meson64 Configurations

SOC_FAMILY = "amlogic:meson-gx"
require conf/machine/include/amlogic-meson.inc

XSERVER:append = " xserver-xf86-config"

KERNEL_IMAGETYPE = "Image"

UBOOT_ENTRYPOINT ?= "0x01080000"
UBOOT_LOADADDRESS ?= "0x1080000"
UBOOT_FDT_LOADADDR ?= "0x01000000"
UBOOT_BOOT_CMD ?= "booti"
UBOOT_KERNEL_NAME ?= "Image"

UBOOT_ROOT ?= "mmcblk0p2"
```

## conf/machine/include/hardkernel.inc
```bitbake
# common Hardkernel settings
#

PREFERRED_PROVIDER_virtual/kernel = "linux-hardkernel"
PREFERRED_VERSION_linux-hardkernel ?= "4.9%"

#specify u-boot parameters
PREFERRED_PROVIDER_virtual/bootloader = "u-boot-hardkernel"
PREFERRED_PROVIDER_u-boot = "u-boot-hardkernel"
PREFERRED_VERSION_u-boot-hardkernel = "2015.01"

SERIAL_CONSOLES = "115200;ttyS0"
UBOOT_CONSOLE = "console=ttyS0,115200"

UBOOT_BINARY = "u-boot.bin"

UBOOT_ENTRYPOINT = "0x01080000"
UBOOT_LOADADDRESS = "0x1080000"

UBOOT_SCRIPT = "boot.ini"
UBOOT_ENV_SUFFIX = "ini"
UBOOT_ENV_CONFIG = "${B}/${UBOOT_ENV}.${UBOOT_ENV_SUFFIX}"

KERNEL_IMAGETYPE = "Image.gz"

IMAGE_BOOT_FILES = "${UBOOT_SCRIPT} ${KERNEL_IMAGETYPE} ${@make_dtb_boot_files(d)} config.ini"

# Review these blacklists when using > 4.9 kernel since they might work and need for
# blacklisting not required

SKIP_RECIPE[kernel-selftest] = "kernel-selftest-1.0/tools/testing/selftests/bpf: No such file or directory."
SKIP_RECIPE[perf] = "needs python2 with kernel 4.9"
```

## conf/machine/include/odroid-arm-defaults.inc
```bitbake
# Odroid BSP Arm default settings
require conf/machine/include/odroid-default-settings.inc

def make_dtb_boot_files(d):
    # Generate IMAGE_BOOT_FILES entries for device tree files listed in
    # KERNEL_DEVICETREE.
    alldtbs = d.getVar('KERNEL_DEVICETREE')

    def transform(dtb):
        base = os.path.basename(dtb)
        if dtb.endswith('dtb'):
            # eg: whatever/meson64_odroidc4.dtb has:
            #     DEPLOYDIR file: meson64_odroidc4.dtb
            #     destination: meson64_odroidc4.dtb
            return base
        elif dtb.endswith('dtbo'):
            # overlay dtb:
            # eg: amlogic/overlays/odroidc4/spi0.dtbo has:
            #     DEPLOYDIR file: spi0.dtbo
            #     destination: amlogic/overlays/odroidc4/spi0.dtbo
            return '{};{}'.format(base, dtb)

    return ' '.join([transform(dtb) for dtb in alldtbs.split(' ') if dtb])

XSERVER:append = " \
    ${@bb.utils.contains('MACHINE_FEATURES', 'mali', 'xserver-xorg-module-exa', '', d)} \
"

KERNEL_IMAGETYPE ?= "zImage"

PREFERRED_PROVIDER_virtual/bootloader ?= "u-boot"
PREFERRED_PROVIDER_u-boot ?= "u-boot"
PREFERRED_VERSION_u-boot ?= "202%"

USE_BOOTSRC ?= "1"
UBOOT_ENV  ?= "boot"
UBOOT_BINARY ?= "u-boot-dtb.bin"
UBOOT_ENV_SUFFIX ?= "scr"
UBOOT_SCRIPT ?= "boot.${UBOOT_ENV_SUFFIX}"
UBOOT_LOAD_CMD ?= "ext4load"
UBOOT_BOOT_CMD ?= "bootz"

UBOOT_BOOTPART ?= "2"
UBOOT_ROOTDEV ?= "1"
UBOOT_ROOTPART ?= "2"
UBOOT_BOOTTYPE ?= "mmc"
BOOT_PREFIX ?= "boot/"

UBOOT_EXTRA_ENV ?= ""
UBOOT_FILE_TITLE ?= "#"
BOOT_PREFIX ?= ""
UBOOT_VIDEO ?= "${@bb.utils.contains("DISTRO_FEATURES", "x11", "drm.edid_firmware=edid/1024x768.bin", " ", d)}"
UBOOT_XTRA_CMDLINE ?=  "${@bb.utils.contains('DISTRO_FEATURES', 'TS_vu7+', 'usbhid.quirks=0x16B4:0x0703:0x00000040 ', '', d)}"

IMAGE_BOOT_FILES ?= "${UBOOT_SCRIPT}"

MACHINE_FEATURES_BACKFILL_CONSIDERED = "rtc"

EXTRA_IMAGEDEPENDS:append = " u-boot secure-odroid"
EXTRA_IMAGEDEPENDS:append = " ${@bb.utils.contains("DISTRO_FEATURES", "x11", " odroid-edid", " ", d)}"
IMAGE_INSTALL:append = " kernel-devicetree"

IMAGE_CLASSES += "image_types_odroid"
```

## conf/machine/include/odroid-default-settings.inc
```bitbake
# Odroid BSP default settings
SOC_FAMILY .= ":odroid"

PREFERRED_PROVIDER_virtual/xserver ?= "xserver-xorg"
XSERVER = " \
    xserver-xorg \
    xf86-video-fbdev \
    xf86-input-evdev \
    xf86-input-mouse \
    xf86-video-modesetting \
    xserver-xorg-module-libint10 \
"

PREFERRED_PROVIDER_virtual/kernel ?= "linux-yocto"
PREFERRED_VERSION_linux-yocto ?= "6.1%"
LINUX_VERSION_EXTENSION ?= "-odroid"

# Do not update fstab file when using wic images
WIC_CREATE_EXTRA_ARGS ?= "--no-fstab-update"

MACHINE_FEATURES:append = " serial usbgadget usbhost ext2"

MACHINE_FEATURES_BACKFILL_CONSIDERED = "rtc"

IMAGE_FSTYPES ?= " ext4 wic wic.xz"
```

## conf/machine/include/odroid-xu-default.inc
```bitbake
# Odroid XU default BSP

require conf/machine/include/samsung-exynos.inc
require conf/machine/include/odroid-arm-defaults.inc

DEFAULTTUNE = "cortexa15thf-neon-vfpv4"
include conf/machine/include/arm/armv7a/tune-cortexa15.inc

UBOOT_FDT_LOADADDR = "0x40800000"
UBOOT_LOADADDR = "0x40007FC0"
UBOOT_LOADADDRESS = "0x40007FC0"
UBOOT_KERNEL_NAME = "zImage"
UBOOT_USB_NET = "1"

WKS_FILE ?= "odroid_xu-u-boot.wks"

MACHINE_FEATURES:append = " alsa screen"
MACHINE_FEATURES:remove = " ${@bb.utils.contains("TCLIBC", "musl", "mali", "", d)}"

VIRTUAL-RUNTIME_mesa = "mesa"
PREFERRED_PROVIDER_virtual/gpu ?= "${@bb.utils.contains("MACHINE_FEATURES", "mali", "mali-t62x", "mesa", d)}"

PREFERRED_PROVIDER_virtual/egl = "${PREFERRED_PROVIDER_virtual/gpu}"
PREFERRED_PROVIDER_virtual/libgbm = "${PREFERRED_PROVIDER_virtual/gpu}"
PREFERRED_PROVIDER_virtual/libgles1 = "${PREFERRED_PROVIDER_virtual/gpu}"
PREFERRED_PROVIDER_virtual/libgles2 = "${PREFERRED_PROVIDER_virtual/gpu}"
PREFERRED_PROVIDER_virtual/libopencl = "${PREFERRED_PROVIDER_virtual/gpu}"
PREFERRED_PROVIDER_virtual/libgl = "${VIRTUAL-RUNTIME_mesa}"
PREFERRED_PROVIDER_virtual/mesa = "${VIRTUAL-RUNTIME_mesa}"

XSERVER:append = " \
    ${@bb.utils.contains('MACHINE_FEATURES', 'x11 mali', 'xf86-video-armsoc', '', d)} \
"

SERIAL_CONSOLES ?= "115200;ttySAC2"
```

## conf/machine/include/rockchip-rk3568.inc
```bitbake
# Rockchip rk3568 config

SOC_FAMILY = "rockchip:rk3568"
require conf/machine/include/soc-family.inc

SERIAL_CONSOLES ?= "1500000;ttyS2"
UBOOT_CONSOLE ?= "console=ttyS2,1500000 earlycon"

KERNEL_IMAGETYPE = "Image.gz"

UBOOT_ENTRYPOINT ?= "0x00A80000"
UBOOT_LOADADDRESS ?= "0x00A80000"
UBOOT_FDT_LOADADDR ?= "0x0A100000"
UBOOT_BOOT_CMD ?= "booti"
UBOOT_KERNEL_NAME ?= "Image.gz"
```

## conf/machine/odroid-c1.conf
```bitbake
#@TYPE: Machine
#@NAME: ODROID-C1
#@DESCRIPTION: Machine configuration for the ODROID-C1 by Hardkernel

require conf/machine/include/amlogic-meson32.inc

DEFAULTTUNE ?= "cortexa5hf-neon"
require conf/machine/include/arm/armv7a/tune-cortexa5.inc
require conf/machine/include/odroid-arm-defaults.inc

PREFERRED_PROVIDER_virtual/bootloader = "u-boot-hardkernel"
PREFERRED_PROVIDER_u-boot = "u-boot-hardkernel"
PREFERRED_VERSION_u-boot-hardkernel = "v2011.03%"

UBOOT_MACHINE ?= "odroidc_config"

UBOOT_SUFFIX ?= "bin"
UBOOT_BINARY = "u-boot.${UBOOT_SUFFIX}"
UBOOT_SYMLINK ?= "u-boot-${MACHINE}.${UBOOT_SUFFIX}"
UBOOT_ENTRYPOINT = "00208000"
KERNEL_EXTRA_ARGS += "LOADADDR=${UBOOT_ENTRYPOINT}"

KERNEL_DEVICETREE ?= "meson8b-odroidc1.dtb"

KERNEL_IMAGETYPE = "uImage"
BOOT_IMAGE ?= "uImage"
UBOOT_ENV_SUFFIX = "ini"
UBOOT_LOADADDRESS = "0x21000000"
UBOOT_FDT_LOADADDR = "0x21800000"
UBOOT_FILE_TITLE = "ODROIDC-UBOOT-CONFIG"
UBOOT_BOOT_CMD = "bootm"
UBOOT_BOOTPART = "1"
UBOOT_KERNEL_NAME ?= "uImage"
UBOOT_SCRIPT = "boot.ini"
BOOT_PREFIX = ""
UBOOT_LOAD_CMD = "fatload"
UBOOT_MULTI_BOOT = "0"

IMAGE_BOOT_FILES = "${BOOT_IMAGE} ${UBOOT_SCRIPT} ${KERNEL_DEVICETREE}"
EXTRA_IMAGEDEPENDS:remove = " secure-odroid"

WKS_FILE ?= "odroid-c1.wks"
```

## conf/machine/odroid-c2-hardkernel.conf
```bitbake
#@TYPE: Machine
#@NAME: odroid-c2-hardkernel
#@DESCRIPTION: Machine configuration for odroid-c2 systems using uboot/kernel from hardkernel supported vendor tree
#@MAINTAINER: Armin Kuster <akuster808@gmail.com>

require conf/machine/odroid-c2.conf

SERIAL_CONSOLE = "115200 ttyS0"

KERNEL_DEVICETREE_FN = "meson64_odroidc2.dtb"
KERNEL_DEVICETREE = "meson64_odroidc2.dtb"

UBOOT_SCRIPT = "boot.ini"
UBOOT_ENV_SUFFIX = "ini"
UBOOT_ENV_CONFIG = "${B}/${UBOOT_ENV}.${UBOOT_ENV_SUFFIX}"
UBOOT_CONSOLE = "console=ttyS0,115200"

PREFERRED_PROVIDER_virtual/kernel = "linux-hardkernel"
PREFERRED_PROVIDER_virtual/bootloader = "u-boot-hardkernel"

PREFERRED_VERSION_linux-libc-headers = "3.16%"
PREFERRED_VERSION_linux-hardkernel = "3.16%"

MACHINEOVERRIDES .= ":odroid-c2"
```

## conf/machine/odroid-c2.conf
```bitbake
#@TYPE: Machine
#@NAME: odroid-c2
#@DESCRIPTION: Machine configuration for odroid-c2 systems
#@MAINTAINER: Armin Kuster <akuster808@gmail.com>

require conf/machine/include/arm/tune-cortexa53.inc
require conf/machine/include/amlogic-meson64.inc

DEFAULTTUNE ?= "cortexa53-crypto"
require conf/machine/include/odroid-arm-defaults.inc

KERNEL_DEVICETREE_FN = "meson-gxbb-odroidc2.dtb"
KERNEL_DEVICETREE = "amlogic/meson-gxbb-odroidc2.dtb"

#specify u-boot parameters
UBOOT_MACHINE = "odroid-c2_defconfig"

KERNEL_IMAGETYPE = "Image"

UBOOT_ENTRYPOINT = "0x01080000"
UBOOT_LOADADDRESS = "0x1080000"

UBOOT_FDT_LOADADDR = "0x01000000"
UBOOT_BOOT_CMD = "booti"
UBOOT_KERNEL_NAME = "Image"

WKS_FILE ?= "odroid-c2.wks"

MACHINE_FEATURES_append = " mali"

VIRTUAL-RUNTIME_mesa = "mesa-gl"
PREFERRED_PROVIDER_virtual/gpu ?= "${@bb.utils.contains("MACHINE_FEATURES", "mali", "mali-450", "mesa-gl", d)}"


PREFERRED_PROVIDER_virtual/egl = "${PREFERRED_PROVIDER_virtual/gpu}"
PREFERRED_PROVIDER_virtual/libgbm = "${PREFERRED_PROVIDER_virtual/gpu}"
PREFERRED_PROVIDER_virtual/libgles1 = "${PREFERRED_PROVIDER_virtual/gpu}"
PREFERRED_PROVIDER_virtual/libgles2 = "${PREFERRED_PROVIDER_virtual/gpu}"
PREFERRED_PROVIDER_virtual/libopencl = "${PREFERRED_PROVIDER_virtual/gpu}"
PREFERRED_PROVIDER_virtual/libgl = "${VIRTUAL-RUNTIME_mesa}"
PREFERRED_PROVIDER_virtual/mesa = "${VIRTUAL-RUNTIME_mesa}"
```

## conf/machine/odroid-c4-hardkernel.conf
```bitbake
#@TYPE: Machine
#@NAME: odroid-c4-hardkernel
#@DESCRIPTION: Machine configuration for Hardkernel odroid-c4 systems
#@MAINTAINER: Armin Kuster <akuster808@gmail.com>

require conf/machine/odroid-c4.conf
require conf/machine/include/hardkernel.inc 

KERNEL_DEVICETREE:append = "\
    amlogic/overlays/odroidc4/spi0.dtbo \
    amlogic/overlays/odroidc4/i2c0.dtbo \
    amlogic/overlays/odroidc4/i2c1.dtbo \
    amlogic/overlays/odroidc4/uart0.dtbo \
    amlogic/overlays/odroidc4/uart1.dtbo \
    amlogic/overlays/odroidc4/uart2.dtbo \
    amlogic/overlays/odroidc4/hktft32.dtbo \
    amlogic/overlays/odroidc4/hktft35.dtbo \
    amlogic/overlays/odroidc4/ads7846.dtbo \
    amlogic/overlays/odroidc4/sx865x-i2c1.dtbo \
    amlogic/overlays/odroidc4/pcf8563.dtbo \
    amlogic/overlays/odroidc4/onewire.dtbo \
    amlogic/overlays/odroidc4/can0.dtbo \
    amlogic/overlays/odroidc4/hifishield.dtbo \
    amlogic/overlays/odroidc4/hifishield2.dtbo \
    amlogic/overlays/odroidc4/lineout.dtbo \
    amlogic/overlays/odroidc4/esp8089.dtbo \
    amlogic/overlays/odroidc4/sdio.dtbo \
    amlogic/overlays/odroidc4/fanspeed-full.dtbo \
    amlogic/overlays/odroidc4/pwm_ab.dtbo \
    amlogic/overlays/odroidc4/pwm_cd.dtbo \
    amlogic/overlays/odroidc4/pwm_ef.dtbo \
    amlogic/overlays/odroidc4/pwm_a-pwmfan.dtbo \
    amlogic/overlays/odroidc4/pwm_b-backlight.dtbo \
"

# This goes into /boot dir of rootfs
IMAGE_INSTALL:remove = "\
                        kernel-image-image kernel-image\
                        kernel-devicetree \
                        "
```

## conf/machine/odroid-c4.conf
```bitbake
#@TYPE: Machine
#@NAME: odroid-c4
#@DESCRIPTION: Machine configuration for odroid-c4 systems
#@MAINTAINER: Armin Kuster <akuster808@gmail.com>

require conf/machine/include/arm/armv8-2a/tune-cortexa55.inc
require conf/machine/include/amlogic-meson64.inc
require conf/machine/include/odroid-arm-defaults.inc

SERIAL_CONSOLE = "115200 ttyS0"

KERNEL_DEVICETREE = "amlogic/meson-sm1-odroid-c4.dtb"

UBOOT_BINARY = "u-boot.bin.sd.bin"

UBOOT_MACHINE = "odroid-c4_defconfig"

UBOOT_ENTRYPOINT = "0x1B00000"
UBOOT_LOADADDRESS = "0x1B00000"

#UBOOT_FILE_TITLE = "ODROIDC4-UBOOT-CONFIG"
UBOOT_VIDEO = "no_console_suspend fsck.repair=yes net.ifnames=0 elevator=noop hdmimode=custombuilt cvbsmode=576cvbs max_freq_a55=1908 max_freq_a73= maxcpus=4 voutmode=hdmi modeline=1920,1200,154000,74038,60,1920,1968,2000,2080,1200,1203,1209,1235,1,0,1 disablehpd=false cvbscable= overscan=100  monitor_onoff=false logo=osd0,loaded hdmitx=cec3f sdrmode=auto"

IMAGE_BOOT_FILES = "${UBOOT_SCRIPT}"

WKS_FILE ?= "odroid-n2.wks"

EXTRA_IMAGEDEPENDS:remove = " secure-odroid odroid-edid"
```

## conf/machine/odroid-h2.conf
```bitbake
#@TYPE: Machine
#@NAME: ODROID-H2
#@DESCRIPTION: Machine configuration for the Intel x86-64
#@MAINTAINER: Armin Kuster <akuster808@gmail.com>

#
# Intel® Quad-Core Processor J4105
# Dual-channel Memory DDR4 up to PC19200 (2400MT/s)
# Total 32GiB RAM Space with two SO-DIMM slots
# 4 x PCIe 2.0 for one M.2 NVMe storage
# 2 x Gbit Ethernet ports
# 2 x SATA 3.0 ports
# SSE4.2 accelerator (SMM, FPU, NX, MMX, SSE, SSE2, SSE3, SSSE3, SSE4.1, SSE4.2, AES)
# Intel UHD Graphics 600 (Gen9.5 GT1) 700Mhz
# HDMI 2.0 and DP 1.2 multiple video outputs


DEFAULTTUNE ?= "core2-64"
require conf/machine/include/x86/tune-core2.inc
require conf/machine/include/odroid-x86-defaults.inc

MACHINE_EXTRA_RRECOMMENDS += "kernel-modules linux-firmware"

MACHINE_FEATURES += "screen keyboard pci usbhost ext2 ext3 x86 \
                     acpi serial usbgadget alsa"

IMAGE_FSTYPES ?= "hddimg"

KERNEL_IMAGETYPE ?= "bzImage"

SERIAL_CONSOLES ?= "115200;ttyS0"

WKS_FILE ?= "odroid-h2.wks"

do_image_wic[depends] += "gptfdisk-native:do_populate_sysroot"
do_image_wic[recrdeptask] += "do_bootimg"
```

## conf/machine/odroid-h3.conf
```bitbake
#@TYPE: Machine
#@NAME: ODROID-H3
#@DESCRIPTION: Machine configuration for the Intel x86-64
#@MAINTAINER: Joshua Watt <JPEWhacker@gmail.com>

#
# Intel® Quad-Core Processor Jasper Lake N5105
# Dual-channel Memory DDR4 up to PC23400 (2933MT/s)
# Total 32GiB RAM Space with two SO-DIMM slots
# 4 x PCIe 3.0 for one M.2 NVMe storage
# 2 x 2.5 Gbit Ethernet ports
# 2 x SATA 3.0 ports
# SSE4.2 accelerator (SMM, FPU, NX, MMX, SSE, SSE2, SSE3, SSSE3, SSE4.1, SSE4.2, AES)
# Intel UHD Graphics 24 EUs Turbo 800MHz
# HDMI 2.0 and DP 1.2 multiple video outputs

DEFAULTTUNE ?= "core2-64"
require conf/machine/include/x86/tune-core2.inc
require conf/machine/include/odroid-x86-defaults.inc

MACHINE_EXTRA_RDEPENDS += "kernel-modules linux-firmware"

MACHINE_FEATURES += "screen keyboard pci usbhost ext2 ext3 x86 \
                     acpi serial usbgadget alsa efi"

IMAGE_INSTALL:append = " kernel-image-bzimage"

KERNEL_IMAGETYPE ?= "bzImage"

SERIAL_CONSOLES ?= "115200;ttyS0"

WKS_FILE ?= "odroid-h3.wks"

do_image_wic[depends] += "gptfdisk-native:do_populate_sysroot"
do_image_wic[recrdeptask] += "do_bootimg"
```

## conf/machine/odroid-hc1.conf
```bitbake
#@TYPE: Machine
#@NAME: odroid-HC1
#@DESCRIPTION: Machine configuration for odroid-HC1 systems
#@MAINTAINER: Armin Kuster <akuster808@gmail.com>


include conf/machine/include/odroid-xu-default.inc

KERNEL_DEVICETREE = "exynos5422-odroidhc1.dtb"
UBOOT_MACHINE:odroid-hc1 = "odroid-xu3_defconfig"

DISTRO_FEATURES:remove = "x11"
MACHINE_FEATURES:remove = "mali"
```
