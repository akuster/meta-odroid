## conf/machine/odroid-hc4-hardkernel.conf
```bitbake
#@TYPE: Machine
#@NAME: odroid-hc4-hardkernel
#@DESCRIPTION: Machine configuration for odroid-hc4 systems
#@MAINTAINER: Armin Kuster <akuster808@gmail.com>

# This uses the hardkernel u-boot and kernel
# Processor   Amlogic S905X3 Processor
# Quad-Core Cortex-A55 (1.800GHz)
# ARMv8-A architecture with Neon and Crypto extensions
# Mali-G31 MP2 GPU with 4 x Execution Engines (650Mhz)
# Memory  DDR4 4GiB with 32-bit bus width
# 1.2Volt low power design
# Storage     1x Micro SD slot (DS/HS mode up to UHS-I SDR104)
# Networking  1 x GbE LAN ports (RJ45, supports 10/100/1000 Mbps)
# - Realtek RTL8211F (Ethernet transceiver)
# - LED indicators
# Video   1 x HDMI 2.0 (up to 4K@60Hz with HDR, CEC, EDID)
# Audio   1 x HDMI digital output 
# External I/O    1 x USB 2.0 host port
# 1 x Debug serial console (UART)
# 2 x SATA Connectors 

# C4 has more devices than we need but its a start.
# Will clean up later.
#

require conf/machine/odroid-c4-hardkernel.conf

KERNEL_DEVICETREE = "amlogic/meson64_odroidhc4.dtb"
```

## conf/machine/odroid-hc4.conf
```bitbake
#@TYPE: Machine
#@NAME: odroid-hc4
#@DESCRIPTION: Machine configuration for odroid-hc4 systems
#@MAINTAINER: Armin Kuster <akuster808@gmail.com>

# This uses the hardkernel u-boot and kernel
# Processor   Amlogic S905X3 Processor
# Quad-Core Cortex-A55 (1.800GHz)
# ARMv8-A architecture with Neon and Crypto extensions
# Mali-G31 MP2 GPU with 4 x Execution Engines (650Mhz)
# Memory  DDR4 4GiB with 32-bit bus width
# 1.2Volt low power design
# Storage     1x Micro SD slot (DS/HS mode up to UHS-I SDR104)
# Networking  1 x GbE LAN ports (RJ45, supports 10/100/1000 Mbps)
# - Realtek RTL8211F (Ethernet transceiver)
# - LED indicators
# Video   1 x HDMI 2.0 (up to 4K@60Hz with HDR, CEC, EDID)
# Audio   1 x HDMI digital output
# External I/O    1 x USB 2.0 host port
# 1 x Debug serial console (UART)
# 2 x SATA Connectors

# C4 has more devices than we need but its a start.

require conf/machine/include/arm/armv8-2a/tune-cortexa55.inc
require conf/machine/include/amlogic-meson64.inc
require conf/machine/include/odroid-arm-defaults.inc

SERIAL_CONSOLE = "115200 ttyS0"

KERNEL_DEVICETREE = "amlogic/meson-sm1-odroid-hc4.dtb"

UBOOT_BINARY = "u-boot.bin.sd.bin"

UBOOT_MACHINE = "odroid-c4_defconfig"

UBOOT_ENTRYPOINT = "0x1B00000"
UBOOT_LOADADDRESS = "0x1B00000"

UBOOT_VIDEO = "no_console_suspend fsck.repair=yes net.ifnames=0 elevator=noop hdmimode=custombuilt cvbsmode=576cvbs max_freq_a55=1908 max_freq_a73= maxcpus=4 voutmode=hdmi modeline=1920,1200,154000,74038,60,1920,1968,2000,2080,1200,1203,1209,1235,1,0,1 disablehpd=false cvbscable= overscan=100  monitor_onoff=false logo=osd0,loaded hdmitx=cec3f sdrmode=auto"

IMAGE_BOOT_FILES = "${UBOOT_SCRIPT}"

WKS_FILE ?= "odroid-n2.wks"

EXTRA_IMAGEDEPENDS:remove = " secure-odroid odroid-edid"
```

## conf/machine/odroid-m1.conf
```bitbake
#@TYPE: Machine
#@NAME: odroid-m1
#@DESCRIPTION: Machine configuration for odroid-m1 systems
#@MAINTAINER: Renato Caldas <renato@calgera.com>

PREFERRED_PROVIDER_virtual/kernel ?= "linux-yocto"
WIC_CREATE_EXTRA_ARGS = ""
MACHINE_EXTRA_RRECOMMENDS = "kernel-modules kernel-devicetree"

require conf/machine/include/arm/armv8-2a/tune-cortexa55.inc
require conf/machine/include/rockchip-rk3568.inc
require conf/machine/include/odroid-arm-defaults.inc

KERNEL_DEVICETREE = "rockchip/rk3568-odroid-m1.dtb"

# FIXME: Selecting the rk2568 evaluation board for now, so that u-boot builds
UBOOT_MACHINE = "evb-rk3568_defconfig"
UBOOT_BINARY = "u-boot-rockchip.bin"
UBOOT_LOAD_CMD = "load"
UBOOT_BOOTPART = "${partition}"
UBOOT_FILE_TITLE = "ODROIDM1-UBOOT-CONFIG"
UBOOT_EXTRA_ENV = "setenv bootlabel YOCTO WIC"
BOOT_PREFIX = ""

UBOOT_ROOT_mmc = "mmcblk0p2"
UBOOT_ROOT_nvme = "nvme0n1p2"
UBOOT_ROOT ?= "${UBOOT_ROOT_mmc}"

IMAGE_BOOT_FILES = "${UBOOT_SCRIPT} ${KERNEL_IMAGETYPE} ${@make_dtb_boot_files(d)}"

WKS_FILE ?= "odroid-m1.wks"

EXTRA_IMAGEDEPENDS:remove ?= " secure-odroid odroid-edid"
```

## conf/machine/odroid-n2-hardkernel.conf
```bitbake
#@TYPE: Machine
#@NAME: odroid-n2
#@DESCRIPTION: Machine configuration for Hardkernel odroid-n2 systems
#@MAINTAINER: Armin Kuster <akuster808@gmail.com>

require conf/machine/include/arm/armv8a/tune-cortexa73-cortexa53.inc
require conf/machine/include/amlogic-meson64.inc

DEFAULTTUNE ?= "cortexa73-cortexa53-crypto"
require conf/machine/include/odroid-arm-defaults.inc
require conf/machine/include/hardkernel.inc

KERNEL_DEVICETREE_FN = "meson64_odroidn2.dtb"
KERNEL_DEVICETREE = "amlogic/meson64_odroidn2.dtb"
KERNEL_EXTRA_FEATURES = ""

UBOOT_MACHINE = "odroidn2_config"

WKS_FILE ?= "odroid-c4.wks"

EXTRA_IMAGEDEPENDS:remove = " secure-odroid odroid-edid"

KERNEL_DEVICETREE:append = "\
    amlogic/overlays/odroidn2/ads7846.dtbo \
    amlogic/overlays/odroidn2/can0.dtbo \
    amlogic/overlays/odroidn2/fanspeed-full.dtbo \
    amlogic/overlays/odroidn2/gpio-joystick0.dtbo \
    amlogic/overlays/odroidn2/gpio-joystick1.dtbo \
    amlogic/overlays/odroidn2/gpio_spdif.dtbo \
    amlogic/overlays/odroidn2/hifishield.dtbo \
    amlogic/overlays/odroidn2/hifishield2.dtbo \
    amlogic/overlays/odroidn2/hktft32.dtbo \
    amlogic/overlays/odroidn2/hktft35.dtbo \
    amlogic/overlays/odroidn2/i2c0.dtbo \
    amlogic/overlays/odroidn2/i2c1.dtbo \
    amlogic/overlays/odroidn2/irblaster.dtbo \
    amlogic/overlays/odroidn2/onewire.dtbo \
    amlogic/overlays/odroidn2/pwm_cd.dtbo \
    amlogic/overlays/odroidn2/pwm_c-pwmfan.dtbo \
    amlogic/overlays/odroidn2/pwm_d-backlight.dtbo \
    amlogic/overlays/odroidn2/pwm_ef.dtbo \
    amlogic/overlays/odroidn2/saradc.dtbo \
    amlogic/overlays/odroidn2/sx865x-i2c1.dtbo \
    amlogic/overlays/odroidn2/spi0.dtbo \
    amlogic/overlays/odroidn2/uart0.dtbo \
    amlogic/overlays/odroidn2/uart1.dtbo \
"
```

## conf/machine/odroid-n2.conf
```bitbake
#@TYPE: Machine
#@NAME: odroid-n2
#@DESCRIPTION: Machine configuration for Hardkernel odroid-n2 systems
#@MAINTAINER: Armin Kuster <akuster808@gmail.com>

require conf/machine/include/arm/armv8a/tune-cortexa73-cortexa53.inc
require conf/machine/include/amlogic-meson64.inc

DEFAULTTUNE ?= "cortexa73-cortexa53-crypto"
require conf/machine/include/odroid-arm-defaults.inc

KERNEL_DEVICETREE = "amlogic/meson-g12b-odroid-n2.dtb"
KERNEL_EXTRA_FEATURES = ""

UBOOT_MACHINE = "odroid-n2_defconfig"
UBOOT_BINARY = "u-boot.bin.sd.bin"
UBOOT_ENTRYPOINT = "0x1B00000"
UBOOT_LOADADDRESS = "0x1B00000"

WKS_FILE ?= "odroid-n2.wks"

EXTRA_IMAGEDEPENDS:remove = " secure-odroid odroid-edid"
```

## conf/machine/odroid-xu3-lite.conf
```bitbake
#@TYPE: Machine
#@NAME: odroid-xu3-lite
#@DESCRIPTION: Machine configuration for odroid-xu3-lite systems
#@MAINTAINER: Armin Kuster <akuster808@gmail.com>


include conf/machine/include/odroid-xu-default.inc

KERNEL_DEVICETREE ?= "exynos5422-odroidxu3-lite.dtb"
UBOOT_MACHINE:odroid-xu3-lite = "odroid-xu3_defconfig"
```

## conf/machine/odroid-xu3.conf
```bitbake
#@TYPE: Machine
#@NAME: odroid-xu3
#@DESCRIPTION: Machine configuration for odroid-xu3 systems
#@MAINTAINER: Armin Kuster <akuster808@gmail.com>


include conf/machine/include/odroid-xu-default.inc

KERNEL_DEVICETREE ?= "exynos5422-odroidxu3.dtb"
UBOOT_MACHINE:odroid-xu3 = "odroid-xu3_defconfig"
```

## conf/machine/odroid-xu4.conf
```bitbake
#@TYPE: Machine
#@NAME: odroid-xu4
#@DESCRIPTION: Machine configuration for odroid-xu4 systems
#@MAINTAINER: Alexandre Tuleu <alexandre.tuleu.2005@polytechnique.org>


include conf/machine/include/odroid-xu-default.inc

KERNEL_DEVICETREE ?= "exynos5422-odroidxu4.dtb"
UBOOT_MACHINE:odroid-xu4 = "odroid-xu3_defconfig"
```

## meta-odroid-extras/conf/layer.conf
```bitbake
# We have a conf and classes directory, add to BBPATH
BBPATH .= ":${LAYERDIR}"

# We have recipes-* directories, add to BBFILES
BBFILES += "${LAYERDIR}/recipes-*/*/*.bb \
	${LAYERDIR}/recipes-*/*/*.bbappend"

BBFILE_COLLECTIONS += "odroid-extras"
BBFILE_PATTERN_odroid-extras := "^${LAYERDIR}/"
BBFILE_PRIORITY_odroid-extras = "6"

LAYERDEPENDS_odroid-extras = "core odroid-layer"
LAYERRECOMMENDS_odroid-extras = "openembedded-layer"

LAYERSERIES_COMPAT_odroid-extras = "sumo thud warrior"

BBFILES_DYNAMIC += " \
    qt5-layer:${LAYERDIR}/dynamic-layers/qt5-layer/*/*/*.bb \
    qt5-layer:${LAYERDIR}/dynamic-layers/qt5-layer/*/*/*.bbappend \
    openembedded-layer:${LAYERDIR}/dynamic-layers/openembedded-layer/*/*/*.bb \
    openembedded-layer:${LAYERDIR}/dynamic-layers/openembedded-layer/*/*/*.bbappend \
"

# Sanity check for meta-odroid-extras layer.
# Setting SKIP_META_ODROID_EXTRAS_SANITY_CHECK to "1" would skip the bbappend files check.
INHERIT += "sanity-meta-odroid-extras"
```

## wic/odroid-c1.wks
```
# short-description: Create SD card image for Hardkernel ODROID-C1 board
# Boot partitions already done

part --source bootimg-partition --ondisk mmcblk --fstype=vfat --label boot --active --align 4 --size 16
part --source rootfs --ondisk mmcblk --fstype=ext4 --label root --align 4

bootloader --ptable msdos
```
