## wic/odroid-c2-flipflop.wks
```
# short-description: Create SD card image for Hardkernel ODROID-C2 board
# Boot partitions already done

# Boot env partition
part --source bootimg-partition --ondisk mmcblk0 --fstype=vfat --label boot --align 1024 --fixed-size 16

# Main Rootfs partition (1G)
part --source rootfs --ondisk mmcblk0 --fstype=ext4 --label primary --align 4096 --fixed-size 1024

# Backup Rootfs partition (1G)
part --source rootfs --ondisk mmcblk0 --fstype=ext4 --label secondary --align 4096 --fixed-size 1024

# User data partition (1M)
part --ondisk mmcblk0 --fstype=ext4 --label data --align 4096 --fixed-size 1

bootloader --ptable msdos
```

## wic/odroid-c2.wks
```
# short-description: Create SD card image for Hardkernel ODROID-C2 board
# Boot partitions already done

# Boot env partition
part --source bootimg-partition --ondisk mmcblk0 --fstype=vfat --label boot --align 1024 --fixed-size 16

# Rootfs partition
part --source rootfs --ondisk mmcblk0 --fstype=ext4 --label rootfs --align 4096

bootloader --ptable msdos
```

## wic/odroid-m1.wks
```
# short-description: Create eMMC image for Hardkernel ODROID-M1 board

# Boot partition (100M)
part --source bootimg-partition --ondisk mmcblk0 --fstype=vfat --label boot --active --align 1024 --fixed-size 100 --use-uuid

# Rootfs partition
part / --source rootfs --ondisk mmcblk0 --fstype=ext4 --label rootfs --align 4096 --use-uuid

bootloader --ptable gpt --timeout=5
```

## wic/odroid-n2.wks
```
# short-description: Create SD card image for Hardkernel ODROID-N2 board
# Boot partitions already done

# Boot env partition (100M)
part --source bootimg-partition --ondisk mmcblk0 --fstype=vfat --label boot --align 4 --fixed-size 16

# Rootfs partition
part --source rootfs --ondisk mmcblk0 --fstype=ext4 --label rootfs --align 4

bootloader --ptable msdos
```

## wic/odroid_xu-u-boot.wks
```
# short-description: Create SD card image with a boot partition
# long-description:
# Create an image that can be written onto a SD card using dd for use
# with Odroid-xu style boards .
# It uses BL1, BL2, Tzsw and u-boot
#
# The disk layout used is:
#  -------------------------------------
# |  Binary   | Block offset| part type |
# |   name    | SD   | eMMC |(eMMC only)|
#  -------------------------------------
# | Bl1       | 1    | 0    |  1 (boot) |
# | Bl2       | 31   | 30   |  1 (boot) |
# | U-boot    | 63   | 62   |  1 (boot) |
# | Tzsw      | 2111 | 2110 |  1 (boot) |
# | Uboot Env | 2625 | 2560 |  0 (user) |
#  -------------------------------------
#
part  --source bootimg-partition --ondisk mmcblk --fstype=vfat --label boot --active --align 4 --size 16
part  --source rootfs --ondisk mmcblk --fstype=ext4 --label rootfs --align 4

bootloader --ptable msdos
```
